## m3rma1d-s1r3n/firmware/c5-arbiter/sdkconfig.defaults
```kconfig
CONFIG_ESP_MAIN_TASK_STACK_SIZE=6144
CONFIG_ESP_TASK_WDT_EN=y
CONFIG_ESP_BROWNOUT_DET=y
```

## m3rma1d-s1r3n/firmware/core-s3/sdkconfig.defaults
```kconfig
CONFIG_ESP_MAIN_TASK_STACK_SIZE=8192
CONFIG_ESP_TASK_WDT_EN=y
CONFIG_ESP_BROWNOUT_DET=y
CONFIG_NVS_ENCRYPTION=n
```

## m3rma1d-s1r3n/firmware/single-s3-cam/sdkconfig.defaults
```kconfig
CONFIG_ESP_MAIN_TASK_STACK_SIZE=12288
CONFIG_ESP_TASK_WDT_EN=y
CONFIG_ESP_BROWNOUT_DET=y
CONFIG_ESPTOOLPY_FLASHSIZE_16MB=y
CONFIG_SPIRAM=y
CONFIG_SPIRAM_MODE_OCT=y
CONFIG_ESP_WIFI_SOFTAP_SUPPORT=y
```
